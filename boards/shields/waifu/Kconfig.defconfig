## boards/shields/waifu/Kconfig.defconfig
```kconfig
# Copyright (c) 2022 The ZMK Contributors
# SPDX-License-Identifier: MIT

if SHIELD_WAIFU_LEFT

config ZMK_KEYBOARD_NAME
    default "WAIFU"
    
config ZMK_SPLIT_ROLE_CENTRAL
    default y

endif

if SHIELD_WAIFU_LEFT || SHIELD_WAIFU_RIGHT

config ZMK_SPLIT
    default y

endif
```

## boards/shields/waifu/Kconfig.shield
```kconfig
# Copyright (c) 2022 The ZMK Contributors
# SPDX-License-Identifier: MIT

config SHIELD_WAIFU_LEFT
    def_bool $(shields_list_contains,waifu_left)

config SHIELD_WAIFU_RIGHT
    def_bool $(shields_list_contains,waifu_right)
```

## config/boards/shields/homy/Kconfig.defconfig
```kconfig
# Copyright (c) 2022 The ZMK Contributors
# SPDX-License-Identifier: MIT

if SHIELD_HOMY_LEFT

config ZMK_KEYBOARD_NAME
    default "Homy Weeb Keeb"
    
config ZMK_SPLIT_ROLE_CENTRAL
    default y

endif

if SHIELD_HOMY_LEFT || SHIELD_HOMY_RIGHT

config ZMK_SPLIT
    default y

endif
```

## config/boards/shields/homy/Kconfig.shield
```kconfig
# Copyright (c) 2022 The ZMK Contributors
# SPDX-License-Identifier: MIT

config SHIELD_HOMY_LEFT
    def_bool $(shields_list_contains,homy_left)

config SHIELD_HOMY_RIGHT
    def_bool $(shields_list_contains,homy_right)
```
